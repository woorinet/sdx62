/dts-v1/;

#include "sdxlemur-v2.dtsi"
#include "sdxlemur-woorinet.dtsi"
#include "sdxlemur-woorinet-cpe-wx-t100.dtsi"
#include "sdxlemur-woorinet-cpe-hsp.dtsi"
#include "sdxlemur-1024mb-cpe.dtsi"

/ {
	model = "WOORINET SDX CPE WX-T100 V2";
	compatible = "qcom,sdxlemur-mtp",
		"qcom,sdxlemur", "qcom,mtp";
	qcom,board-id = <0x43010008 0x343>;
};
