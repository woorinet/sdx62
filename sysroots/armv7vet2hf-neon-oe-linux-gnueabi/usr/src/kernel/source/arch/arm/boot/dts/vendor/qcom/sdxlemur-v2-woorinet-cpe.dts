/dts-v1/;

#include "sdxlemur-v2.dtsi"
#include "sdxlemur-woorinet.dtsi"
#include "sdxlemur-woorinet-cpe.dtsi"
#include "sdxlemur-woorinet-cpe-hsp.dtsi"
#include "sdxlemur-1024mb-cpe.dtsi"

/ {
	model = "WOORINET SDX CPE EGG V2";
	compatible = "qcom,sdxlemur-mtp",
		"qcom,sdxlemur", "qcom,mtp";
	qcom,board-id = <0x42010008 0x342>;
};
