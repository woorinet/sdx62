/dts-v1/;

#include "sdxlemur-v2.dtsi"
#include "sdxlemur-woorinet.dtsi"
#include "sdxlemur-woorinet-ep.dtsi"
#include "sdxlemur-1024mb-cpe.dtsi"

/ {
	model = "WOORINET SDX PCIe-EP";
	compatible = "qcom,sdxlemur-mtp",
		"qcom,sdxlemur", "qcom,mtp";
	qcom,board-id = <0x41010008 0x341>;
};
